## openembedded/conf/distro/include/shr-autorev.inc
```bitbake
SRCREV_pn-frameworkd = "a8d607e8c2172dc3685dcb797bc384c2761414ed"
SRCREV_pn-fso-gpsd = "${AUTOREV}"
SRCREV_pn-fso-sounds = "${AUTOREV}"
SRCREV_pn-gsm0710muxd = "${AUTOREV}"
SRCREV_pn-gsmd2 = "${AUTOREV}"
SRCREV_pn-illume-theme-freesmartphone = "${AUTOREV}"
SRCREV_pn-mickeydbus = "${AUTOREV}"
SRCREV_pn-mickeyterm = "${AUTOREV}"
SRCREV_pn-python-pytrc = "${AUTOREV}"
SRCREV_pn-zhone = "${AUTOREV}"
SRCREV_pn-openmoko-terminal2 = "4604"
SRCREV_pn-webkit-gtk = "${AUTOREV}"
SRCREV_pn-navit = "${AUTOREV}"
 
+PREFERRED_VERSION_vala-native = "0.1.5"
+PREFERRED_VERSION_vala = "0.1.5"
+PREFERRED_VERSION_midori = "0.1.0"


# SRCREV_pn-libframeworkd-glib = "${AUTOREV}"
# SRCREV_pn-ophonekitd = "${AUTOREV}"
# SRCREV_pn-openmoko-messages3 = "${AUTOREV}"
# SRCREV_pn-openmoko-contacts3 = "${AUTOREV}"
# SRCREV_pn-openmoko-dialer3 = "${AUTOREV}"
SRCREV_pn-libframeworkd-phonegui-efl = "391"
# SRCREV_pn-libframeworkd-phonegui = "${AUTOREV}"
```
